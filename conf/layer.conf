## conf/layer.conf
```bitbake
# We have a conf and classes directory, add to BBPATH
BBPATH .= ":${LAYERDIR}"

# We have recipes-* directories, add to BBFILES
BBFILES += "${LAYERDIR}/recipes-*/*/*.bb \
            ${LAYERDIR}/recipes-*/*/*.bbappend"

BBFILE_COLLECTIONS += "meta-sevenseg"
BBFILE_PATTERN_meta-sevenseg = "^${LAYERDIR}/"
BBFILE_PRIORITY_meta-sevenseg = "6"

LAYERDEPENDS_meta-sevenseg = "core"
LAYERSERIES_COMPAT_meta-sevenseg = "dunfell"
```
